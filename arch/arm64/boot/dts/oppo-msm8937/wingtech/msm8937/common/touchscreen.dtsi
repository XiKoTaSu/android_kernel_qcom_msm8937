&soc {
	vkeys_fts: gen-vkey1 {
#ifndef CONFIG_TOUCHSCREEN_FTS_MI8937
		compatible = "qcom,gen-vkeys";
#endif
		label = "ft5x06_720p";
		qcom,disp-maxx = <720>;
		qcom,disp-maxy = <1280>;
		qcom,panel-maxx = <720>;
		qcom,panel-maxy = <1458>;
		qcom,key-codes = <139 172 158>;
		qcom,y-offset = <0>;
	};
};

